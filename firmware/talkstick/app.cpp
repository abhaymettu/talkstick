// talkstick firmware: push-to-talk on an M5StickS3, streaming 16 kHz PCM to a Mac daemon (protocol M5R1).
#include <Arduino.h>
#include <M5Unified.h>
#include <WiFi.h>
#include <ESPmDNS.h>
#include <esp_sleep.h>
#include <esp_ota_ops.h>
#include <driver/rtc_io.h>
#include <sys/time.h>
#include <atomic>
#include <vector>

#include "talkstick_config.h"  // generated by build.sh, never committed
#include "fonts.h"

#ifdef TS_OTA_KEY
#include <Update.h>
#include <mbedtls/md.h>
#include <mbedtls/sha256.h>
static const uint8_t OTA_KEY[32] = TS_OTA_KEY;
#endif

static constexpr const char* FW_VERSION = "talkstick-0.3.2";

static constexpr gpio_num_t PTT_PIN = GPIO_NUM_11;
static constexpr int PRESSED_LEVEL = 0;
static constexpr uint32_t DEBOUNCE_MS = 20;

static constexpr uint32_t SAMPLE_RATE = 16000;
static constexpr size_t CHUNK_SAMPLES = 512;
static constexpr size_t CHUNK_BYTES = CHUNK_SAMPLES * sizeof(int16_t);
static constexpr uint32_t STATUS_PRESS_MS = 300;
static constexpr uint32_t MAX_RECORD_MS = 120000;
static constexpr size_t MAX_CHUNKS = (SAMPLE_RATE * (MAX_RECORD_MS / 1000 + 2)) / CHUNK_SAMPLES;
static constexpr size_t BUF_BYTES = MAX_CHUNKS * CHUNK_BYTES;
static constexpr size_t FRAME_MAX_BYTES = 4096;

static constexpr uint32_t UTT_CONNECT_MS = 1000;
static constexpr uint32_t CACHED_CONNECT_MS = 1500;
static constexpr uint32_t JOIN_GRACE_MS = 15000;
static constexpr uint32_t SEARCH_GRACE_MS = 8000;
static constexpr uint32_t WATCH_SILENCE_MS = 12000;
static constexpr uint32_t REJOIN_MS = 20000;
static constexpr uint32_t FAST_JOIN_MS = 4000;

static constexpr uint32_t NO_LINK_MS = 25000;
static constexpr uint32_t SENT_TIMEOUT_MS = 45000;
static constexpr uint32_t RETRY_WINDOW_MS = 120000;
static constexpr uint32_t BUSY_RETRY_MS = 2000;
static constexpr uint32_t STATUS_GUARD_MS = 90000;

static constexpr uint32_t DELIVERED_HOLD_MS = 1800;
static constexpr uint32_t PROBLEM_HOLD_MS = 5000;
static constexpr uint32_t NOTICE_HOLD_MS = 1500;
static constexpr uint32_t REPLY_BASE_MS = 5000;
static constexpr uint32_t REPLY_PER_CHAR_MS = 40;
static constexpr uint32_t REPLY_MAX_HOLD_MS = 20000;
static constexpr uint32_t THINKING_AFTER_DELIVERY_MS = 120000;
static constexpr uint32_t THINKING_AFTER_BUTTON_MS = 30000;
static constexpr uint32_t ITEM_MAX_AGE_MS = 15UL * 60UL * 1000UL;
static constexpr uint32_t IDLE_SLEEP_MS = 60000;
static constexpr uint32_t STAY_AWAKE_AFTER_DELIVERY_MS = 11UL * 60UL * 1000UL;
static constexpr uint32_t USB_DIM_MS = 10000;
static constexpr uint32_t PROBATION_MS = 120000;
static constexpr uint32_t UPDATED_SHOW_S = 120;
static constexpr uint32_t DEMO_MS = 10000;

static constexpr uint8_t BRIGHT_ACTIVE = 160;
static constexpr uint8_t BRIGHT_DIM = 24;
static constexpr uint8_t SPEAKER_VOLUME = 40;

static constexpr size_t REPLY_MAX = 640;
static constexpr size_t SAID_MAX = 40;
static constexpr size_t INBOX_N = 4;
static constexpr size_t ITEMS_N = 8;
static constexpr size_t DIAG_MAX = 640;
static constexpr uint32_t DIAG_MAGIC = 0x7a1c0003;

RTC_DATA_ATTR static uint32_t rtc_host_ip = 0;
RTC_DATA_ATTR static uint16_t rtc_host_port = 0;
RTC_DATA_ATTR static uint8_t rtc_wifi_bssid[6];
RTC_DATA_ATTR static int32_t rtc_wifi_channel = 0;
RTC_DATA_ATTR static uint32_t rtc_boot_count = 0;
RTC_DATA_ATTR static int32_t rtc_utc_offset = 0;
RTC_DATA_ATTR static bool rtc_sound_on = true;
RTC_DATA_ATTR static int64_t rtc_updated_epoch = 0;

struct Answer {
  char id[9];
  char outcome;  // r replied, o offline, e error
  char said[SAID_MAX + 1];
  char text[REPLY_MAX + 1];
  bool read;
};
RTC_DATA_ATTR static Answer rtc_inbox[INBOX_N];
RTC_DATA_ATTR static uint8_t rtc_inbox_n = 0;

// Survives a software restart as well as deep sleep, so a rollback or a crash still uploads why.
RTC_NOINIT_ATTR static uint32_t rtc_diag_magic;
RTC_NOINIT_ATTR static uint16_t rtc_diag_len;
RTC_NOINIT_ATTR static char rtc_diag[DIAG_MAX];

// Sounds. The speaker and the mic share the codec, so the recorder task, which owns the mic,
// is the only place either is started.
enum class Sound : uint8_t { None, Listen, Sent, Replied, Error };

static void play_tones(Sound s) {
  M5.Speaker.begin();
  M5.Speaker.setVolume(SPEAKER_VOLUME);
  auto tone = [](float hz, uint32_t ms) {
    M5.Speaker.tone(hz, ms);
    while (M5.Speaker.isPlaying()) vTaskDelay(1);
  };
  switch (s) {
    case Sound::Listen: tone(2600, 14); break;
    case Sound::Sent: tone(1800, 12); vTaskDelay(70); tone(1800, 12); break;
    case Sound::Replied: tone(1200, 40); tone(1800, 60); break;
    case Sound::Error: tone(380, 90); break;
    case Sound::None: break;
  }
  M5.Speaker.end();
}

// Recorder: one task owns button A, the mic and the speaker, so a blocking network call in loop()
// can never drop audio or miss the release.
struct Recorder {
  int16_t* buf = nullptr;
  std::atomic<bool> armed{true};
  std::atomic<bool> active{false};
  std::atomic<bool> finished{true};
  std::atomic<bool> capped{false};
  std::atomic<bool> cancel_req{false};
  std::atomic<bool> cancelled{false};
  std::atomic<uint32_t> seq{0};
  std::atomic<size_t> done_bytes{0};
  std::atomic<uint32_t> press_ms{0};
  std::atomic<uint32_t> release_ms{0};
  std::atomic<uint32_t> sim_until_ms{0};
  std::atomic<uint8_t> sound{(uint8_t)Sound::None};
  size_t queued_chunks = 0;
  bool mic_on = false;
};
static Recorder rec;

static void request_sound(Sound s) {
  if (rtc_sound_on) rec.sound.store((uint8_t)s);
}

static void recorder_task(void*) {
  bool stable = false;
  bool last_raw = false;
  uint32_t last_change = 0;
  for (;;) {
    uint32_t now = millis();
    uint32_t sim_until = rec.sim_until_ms.load();
    bool sim = sim_until && (int32_t)(sim_until - now) > 0;
    if (sim_until && !sim) rec.sim_until_ms.store(0);
    bool raw = gpio_get_level(PTT_PIN) == PRESSED_LEVEL || sim;
    if (raw != last_raw) { last_raw = raw; last_change = now; }
    bool pressed = stable;
    if (raw != stable && (sim || now - last_change >= DEBOUNCE_MS)) pressed = raw;

    if (pressed && !stable && rec.armed.load() && !rec.active.load()) {
      // No click here: the speaker needs the codec, and restarting the mic after it loses about 0.9 s of speech.
      if (!rec.mic_on) rec.mic_on = M5.Mic.begin();
      rec.queued_chunks = 0;
      rec.done_bytes.store(0);
      rec.capped.store(false);
      rec.cancel_req.store(false);
      rec.cancelled.store(false);
      rec.finished.store(false);
      rec.press_ms.store(now);
      rec.release_ms.store(0);
      rec.active.store(true);
      rec.seq.fetch_add(1);
    }
    if (rec.active.load()) {
      bool over_cap = now - rec.press_ms.load() >= MAX_RECORD_MS;
      bool cancel = rec.cancel_req.exchange(false);
      if (!pressed || over_cap || cancel) {
        rec.capped.store(over_cap && pressed && !cancel);
        rec.cancelled.store(cancel);
        rec.release_ms.store(now);
        rec.active.store(false);
      } else if (rec.queued_chunks < MAX_CHUNKS && M5.Mic.isRecording() < 2) {
        if (M5.Mic.record(rec.buf + rec.queued_chunks * CHUNK_SAMPLES, CHUNK_SAMPLES, SAMPLE_RATE)) {
          rec.queued_chunks++;
        }
      }
    }
    if (!rec.finished.load()) {
      size_t in_flight = M5.Mic.isRecording();
      rec.done_bytes.store((rec.queued_chunks - in_flight) * CHUNK_BYTES);
      if (!rec.active.load() && in_flight == 0) {
        rec.finished.store(true);
      }
    }
    Sound s = (Sound)rec.sound.load();
    if (s != Sound::None && rec.finished.load() && !rec.active.load()) {
      rec.sound.store((uint8_t)Sound::None);
      if (rec.mic_on) { M5.Mic.end(); rec.mic_on = false; }
      play_tones(s);
    }
    // The mic stays running while the stick is awake, so a press records at once.
    if (!rec.mic_on && rec.finished.load() && !rec.active.load()) rec.mic_on = M5.Mic.begin();
    stable = pressed;
    vTaskDelay(1);
  }
}

// Reply text: the daemon sends UTF-8 with newlines escaped as "\n"; the display font is ASCII.
static String sanitize_reply(const String& in, size_t max = REPLY_MAX) {
  String out;
  out.reserve(in.length());
  for (size_t i = 0; i < in.length() && out.length() < max; i++) {
    uint8_t c = in[i];
    if (c == '\\' && i + 1 < in.length() && in[i + 1] == 'n') { out += '\n'; i++; continue; }
    if (c < 0x80) { if (c >= 0x20) out += (char)c; continue; }
    uint32_t cp = 0;
    int extra = c >= 0xF0 ? 3 : c >= 0xE0 ? 2 : c >= 0xC0 ? 1 : 0;
    cp = c & (0x3F >> extra);
    for (int k = 0; k < extra && i + 1 < in.length(); k++) cp = (cp << 6) | (in[++i] & 0x3F);
    switch (cp) {
      case 0x2018: case 0x2019: out += '\''; break;
      case 0x201C: case 0x201D: out += '"'; break;
      case 0x2013: case 0x2014: out += '-'; break;
      case 0x2026: out += "..."; break;
      case 0x00A0: out += ' '; break;
      default: out += '?'; break;
    }
  }
  if (out.length() > max) out.remove(max);
  return out;
}

static void copy_str(char* dst, size_t cap, const String& s) {
  strncpy(dst, s.c_str(), cap - 1);
  dst[cap - 1] = 0;
}

// Diagnostics ring: failures the stick saw while nobody watched the serial port, uploaded as `L` on the next
// watch connection.
static SemaphoreHandle_t diag_mtx;

static void diag(const char* fmt, ...) {
  char msg[160];
  va_list ap;
  va_start(ap, fmt);
  vsnprintf(msg, sizeof msg, fmt, ap);
  va_end(ap);
  char line[200];
  int n = snprintf(line, sizeof line, "b%lu t%.1fs %s\n", (unsigned long)rtc_boot_count, millis() / 1000.0f, msg);
  if (n <= 0) return;
  size_t len = (size_t)n < sizeof line ? (size_t)n : sizeof line - 1;
  Serial.printf("[%lu] diag %s", millis(), line);
  xSemaphoreTake(diag_mtx, portMAX_DELAY);
  while (rtc_diag_len && rtc_diag_len + len > DIAG_MAX) {
    const char* nl = (const char*)memchr(rtc_diag, '\n', rtc_diag_len);
    size_t drop = nl ? (size_t)(nl - rtc_diag) + 1 : rtc_diag_len;
    memmove(rtc_diag, rtc_diag + drop, rtc_diag_len - drop);
    rtc_diag_len -= drop;
  }
  if (len <= DIAG_MAX) {
    memcpy(rtc_diag + rtc_diag_len, line, len);
    rtc_diag_len += len;
  }
  xSemaphoreGive(diag_mtx);
}

static size_t diag_take(char* out) {
  xSemaphoreTake(diag_mtx, portMAX_DELAY);
  size_t n = rtc_diag_len;
  memcpy(out, rtc_diag, n);
  rtc_diag_len = 0;
  xSemaphoreGive(diag_mtx);
  return n;
}

// State shared between the network task (writer) and the main loop (reader). One mutex guards it and the inbox.
enum class LinkState : uint8_t { Joining, NoWifi, Searching, Unreachable, Up };
enum class OtaState : uint8_t { None, Running, Restarting };

static const char* link_name(LinkState l) {
  switch (l) {
    case LinkState::Joining: return "joining";
    case LinkState::NoWifi: return "no-wifi";
    case LinkState::Searching: return "searching";
    case LinkState::Unreachable: return "unreachable";
    case LinkState::Up: return "up";
  }
  return "?";
}

struct Item {
  char id[9];
  char said[SAID_MAX + 1];
  uint32_t sent_ms;
};

struct Shared {
  LinkState link = LinkState::Joining;
  IPAddress ip;
  uint16_t port = 0;
  uint32_t last_line_ms = 0;
  bool queue_known = false;
  int waiting = 0, busy = 0, ahead = 0, paused = 0;
  Item items[ITEMS_N];
  uint8_t n_items = 0;
  char status_id[9] = "";
  uint32_t status_ms = 0;
  OtaState ota = OtaState::None;
  int ota_pct = 0;
  char ota_version[24] = "";
  bool wifi_ps = false;
  // Written by the main loop.
  bool keep_awake = true;
  bool main_idle = false;
};
static Shared sh;
static SemaphoreHandle_t mtx;

struct Lock {
  Lock() { xSemaphoreTake(mtx, portMAX_DELAY); }
  ~Lock() { xSemaphoreGive(mtx); }
};

static Shared snapshot() {
  Lock l;
  return sh;
}

static std::atomic<bool> probation{false};
static std::atomic<int> batt_cached{0};

// Inbox, oldest first. Callers hold the lock.
static int inbox_find(const char* id) {
  for (int i = 0; i < rtc_inbox_n; i++) if (!strcmp(rtc_inbox[i].id, id)) return i;
  return -1;
}

static int inbox_oldest_unread() {
  for (int i = 0; i < rtc_inbox_n; i++) if (!rtc_inbox[i].read) return i;
  return -1;
}

static bool inbox_add(const char* id, char outcome, const String& said, const String& text) {
  if (inbox_find(id) >= 0) return false;
  if (rtc_inbox_n == INBOX_N) {
    int drop = 0;
    for (int i = 0; i < rtc_inbox_n; i++) if (rtc_inbox[i].read) { drop = i; break; }
    memmove(&rtc_inbox[drop], &rtc_inbox[drop + 1], (rtc_inbox_n - drop - 1) * sizeof(Answer));
    rtc_inbox_n--;
  }
  Answer& a = rtc_inbox[rtc_inbox_n++];
  copy_str(a.id, sizeof a.id, String(id));
  a.outcome = outcome;
  copy_str(a.said, sizeof a.said, sanitize_reply(said, SAID_MAX));
  copy_str(a.text, sizeof a.text, sanitize_reply(text));
  a.read = false;
  return true;
}

static void items_remove(const char* id) {
  for (int i = 0; i < sh.n_items; i++) {
    if (strcmp(sh.items[i].id, id)) continue;
    memmove(&sh.items[i], &sh.items[i + 1], (sh.n_items - i - 1) * sizeof(Item));
    sh.n_items--;
    return;
  }
}

static int waiting_count(const Shared& s) {
  int q = (s.link == LinkState::Up && s.queue_known) ? s.waiting : 0;
  return q > s.n_items ? q : s.n_items;
}

// Screen. Each view is a display list built from state by one builder per screen; paint() draws whatever
// the list holds, and the list's key decides whether anything changed.
static M5Canvas canvas(&M5.Display);

static constexpr uint16_t rgb(uint32_t hex) {
  return (uint16_t)(((hex >> 8) & 0xF800) | ((hex >> 5) & 0x07E0) | ((hex >> 3) & 0x001F));
}
static constexpr uint16_t C_BG = rgb(0x101010);
static constexpr uint16_t C_TEXT = rgb(0xEDEDED);
static constexpr uint16_t C_DIM = rgb(0x9A9A9E);
static constexpr uint16_t C_FAINT = rgb(0x5E5E63);
static constexpr uint16_t C_TRACK = rgb(0x242424);
static constexpr uint16_t C_YELLOW = rgb(0xF0E442);
static constexpr uint16_t C_ORANGE = rgb(0xE69F00);
static constexpr uint16_t C_SKY = rgb(0x56B4E9);
static constexpr uint16_t C_GREEN = rgb(0x009E73);

#define LQ "\xE2\x80\x9C"
#define RQ "\xE2\x80\x9D"
#define ELLIPSIS "\xE2\x80\xA6"
#define MIDDOT " \xC2\xB7 "

static lgfx::PointerWrapper w_clock, w_title, w_body, w_meta;
static lgfx::VLWfont F_CLOCK, F_TITLE, F_BODY, F_META;

static constexpr int W = 240, H = 135, M = 14, TEXT_W = W - 2 * M;
static constexpr int Y_TITLE = 36, Y_BODY1 = 64, Y_BODY2 = 84, Y_META = 123;
static constexpr int Y_CLOCK = 62, Y_STATUS = 94, Y_HOME_META = 118;
static constexpr int Y_REPLY_TOP = 22, Y_REPLY_BODY = 46, REPLY_LEADING = 19, REPLY_LINES = 5;
static constexpr int BARS = 40, BAR_W = 3, BAR_GAP = 2, BARS_Y = 78, BAR_MIN = 2, BAR_MAX = 34;

struct Text {
  String s;
  const lgfx::IFont* font = nullptr;
  uint16_t color = 0;
  int16_t x = 0, y = 0;
  textdatum_t datum = baseline_left;
};

struct Screen {
  const char* name = "idle";
  Text texts[10];
  uint8_t n = 0;
  bool paw = false;
  bool check = false;
  int8_t progress = -1;
  bool bars = false;
  uint8_t levels[BARS] = {};

  void add(const String& s, const lgfx::IFont* f, uint16_t c, int x, int y, textdatum_t d = baseline_left) {
    if (n < 10 && s.length()) texts[n++] = Text{s, f, c, (int16_t)x, (int16_t)y, d};
  }
  String key() const {
    String k = String(name) + (paw ? "P" : "") + (check ? "C" : "") + String(progress);
    if (bars) for (int i = 0; i < BARS; i++) k += (char)('A' + levels[i]);
    for (int i = 0; i < n; i++) k += "|" + texts[i].s + "@" + String(texts[i].color) + "," + String(texts[i].y);
    return k;
  }
};

static int text_width(const String& s, const lgfx::IFont* f) {
  canvas.setFont(f);
  return canvas.textWidth(s);
}

// pre + body + post, with the body cut at a character boundary and an ellipsis added when it does not fit.
static String fit(const String& body, const lgfx::IFont* f, int max_w, const char* pre = "", const char* post = "") {
  String whole = String(pre) + body + post;
  if (text_width(whole, f) <= max_w) return whole;
  String t = body;
  while (t.length()) {
    int i = t.length() - 1;
    while (i > 0 && ((uint8_t)t[i] & 0xC0) == 0x80) i--;
    t.remove(i);
    t.trim();
    String c = String(pre) + t + ELLIPSIS + post;
    if (text_width(c, f) <= max_w) return c;
  }
  return String(pre) + ELLIPSIS + post;
}

static std::vector<String> wrap_text(const String& text, const lgfx::IFont* f, int max_w) {
  std::vector<String> lines;
  canvas.setFont(f);
  String line, word;
  auto flush_word = [&]() {
    if (!word.length()) return;
    String candidate = line.length() ? line + " " + word : word;
    if (canvas.textWidth(candidate) <= max_w) { line = candidate; word = ""; return; }
    if (line.length()) { lines.push_back(line); line = ""; }
    while (canvas.textWidth(word) > max_w) {
      size_t n = word.length();
      while (n > 1 && canvas.textWidth(word.substring(0, n)) > max_w) n--;
      lines.push_back(word.substring(0, n));
      word = word.substring(n);
    }
    line = word;
    word = "";
  };
  for (size_t i = 0; i < text.length(); i++) {
    char ch = text[i];
    if (ch == '\n') { flush_word(); lines.push_back(line); line = ""; }
    else if (ch == ' ') flush_word();
    else word += ch;
  }
  flush_word();
  if (line.length()) lines.push_back(line);
  return lines;
}

// Up to two lines of body text; the second ends in an ellipsis when more was cut.
static void add_two_lines(Screen& sc, const String& text, uint16_t color) {
  std::vector<String> lines = wrap_text(text, &F_BODY, TEXT_W);
  if (lines.size() > 2) lines[1] = fit(lines[1] + " " + lines[2] + "...", &F_BODY, TEXT_W);
  for (size_t i = 0; i < lines.size() && i < 2; i++) sc.add(lines[i], &F_BODY, color, M, i ? Y_BODY2 : Y_BODY1);
}

static String mmss(uint32_t secs) {
  char buf[12];
  snprintf(buf, sizeof buf, "%lu:%02lu", (unsigned long)(secs / 60), (unsigned long)(secs % 60));
  return buf;
}

static String waiting_text(int n) { return n > 0 ? String(n) + " waiting" : String(); }

static String short_version(const char* v) {
  String s(v);
  if (s.startsWith("talkstick-")) s.remove(0, 10);
  return s;
}

static void add_title(Screen& sc, const String& title, uint16_t color, int x = M) {
  sc.add(title, &F_TITLE, color, x, Y_TITLE);
}

static void add_waiting_meta(Screen& sc, int waiting) {
  sc.add(waiting_text(waiting), &F_META, C_SKY, W - M, Y_META, baseline_right);
}

static Screen scr_home(const String& clock, const String& status, uint16_t status_color, int waiting,
                       const String& meta, uint16_t meta_color) {
  Screen sc;
  sc.name = "idle";
  sc.add(clock, &F_CLOCK, clock == "--:--" ? C_FAINT : C_TEXT, M - 3, Y_CLOCK);
  String right = waiting_text(waiting);
  int room = TEXT_W - (right.length() ? text_width(right, &F_BODY) + 10 : 0);
  sc.add(fit(status, &F_BODY, room), &F_BODY, status_color, M, Y_STATUS);
  sc.add(right, &F_BODY, C_SKY, W - M, Y_STATUS, baseline_right);
  sc.add(fit(meta, &F_META, TEXT_W), &F_META, meta_color, M, Y_HOME_META);
  return sc;
}

static void link_status(LinkState link, bool updated, String& text, uint16_t& color) {
  switch (link) {
    case LinkState::Up:
      text = updated ? "Updated to " + short_version(FW_VERSION) : String("Ready");
      color = updated ? C_GREEN : C_TEXT;
      break;
    case LinkState::Joining: text = "Joining WiFi"; color = C_DIM; break;
    case LinkState::Searching: text = "Finding the Mac"; color = C_DIM; break;
    case LinkState::NoWifi: text = "No WiFi"; color = C_ORANGE; break;
    case LinkState::Unreachable: text = "Can't reach the Mac"; color = C_ORANGE; break;
  }
}

static void power_meta(bool wifi_up, int rssi, int batt, bool usb, String& text, uint16_t& color) {
  color = C_DIM;
  if (!usb && batt < 15) {
    text = "Battery low " + String(batt) + "%";
    color = C_ORANGE;
    return;
  }
  text = "";
  if (wifi_up) text = String("WiFi ") + (rssi > -60 ? "strong" : rssi > -70 ? "good" : "weak") + MIDDOT;
  text += String(batt) + "%";
  if (usb) text += batt < 100 ? MIDDOT "charging" : MIDDOT "charged";
}

static Screen scr_listening(bool live, uint32_t held_ms, const uint8_t* levels) {
  Screen sc;
  sc.name = "listening";
  add_title(sc, live ? "Listening" : "Wait", live ? C_YELLOW : C_DIM);
  sc.add(mmss(held_ms / 1000), &F_META, C_DIM, W - M, Y_TITLE, baseline_right);
  sc.bars = true;
  memcpy(sc.levels, levels, BARS);
  uint32_t held = held_ms / 1000;
  if (held >= 100) sc.add("Ends in " + String(MAX_RECORD_MS / 1000 - held) + " s", &F_META, C_ORANGE, M, Y_META);
  else sc.add("B cancels", &F_META, C_DIM, M, Y_META);
  return sc;
}

static Screen scr_sending(const String& step, int waiting) {
  Screen sc;
  sc.name = "sending";
  add_title(sc, "Sending", C_TEXT);
  sc.add(step, &F_BODY, C_TEXT, M, Y_BODY1);
  add_waiting_meta(sc, waiting);
  return sc;
}

static Screen scr_delivered(const String& said, int waiting) {
  Screen sc;
  sc.name = "delivered";
  sc.check = true;
  add_title(sc, "Delivered", C_GREEN, M + 24);
  if (said.length()) {
    std::vector<String> lines = wrap_text(LQ + said + RQ, &F_BODY, TEXT_W);
    if (lines.size() > 2) lines[1] = fit(lines[1] + " " + lines[2], &F_BODY, TEXT_W, "", RQ);
    for (size_t i = 0; i < lines.size() && i < 2; i++) sc.add(lines[i], &F_BODY, C_TEXT, M, i ? Y_BODY2 : Y_BODY1);
  }
  add_waiting_meta(sc, waiting);
  return sc;
}

static Screen scr_thinking(int busy, int ahead, int paused, int64_t elapsed_s, const String& said, int waiting) {
  Screen sc;
  sc.name = "thinking";
  if (paused) {
    add_title(sc, "Paused", C_ORANGE);
    sc.add("Turn stopped, waiting in T3", &F_BODY, C_TEXT, M, Y_BODY1);
  } else if (busy || ahead > 0) {
    add_title(sc, "Queued", C_SKY);
    sc.add(ahead > 0 ? "Driver busy, " + String(ahead) + " ahead" : String("Driver busy"), &F_BODY, C_TEXT, M, Y_BODY1);
  } else {
    add_title(sc, "Thinking", C_SKY);
    sc.add("Driver is on it", &F_BODY, C_TEXT, M, Y_BODY1);
  }
  if (elapsed_s >= 0) sc.add(mmss((uint32_t)elapsed_s), &F_META, C_DIM, W - M, Y_TITLE, baseline_right);
  if (said.length()) sc.add(fit(said, &F_META, TEXT_W, LQ, RQ), &F_META, C_DIM, M, Y_BODY2);
  add_waiting_meta(sc, waiting);
  return sc;
}

static Screen scr_reply(char outcome, const String& said, const std::vector<String>& lines, int page) {
  Screen sc;
  sc.name = "reply";
  int pages = lines.empty() ? 1 : (int)((lines.size() + REPLY_LINES - 1) / REPLY_LINES);
  String right = pages > 1 ? String(page + 1) + "/" + String(pages) : String();
  int room = TEXT_W - (right.length() ? text_width(right, &F_META) + 8 : 0);
  if (outcome == 'r') {
    sc.paw = true;
    if (said.length()) sc.add(fit(said, &F_META, room - 18, LQ, RQ), &F_META, C_DIM, M + 18, Y_REPLY_TOP);
  } else {
    sc.name = "noreply";
    sc.add("No reply", &F_META, C_ORANGE, M, Y_REPLY_TOP);
  }
  sc.add(right, &F_META, C_DIM, W - M, Y_REPLY_TOP, baseline_right);
  for (int i = 0; i < REPLY_LINES; i++) {
    size_t idx = (size_t)page * REPLY_LINES + i;
    if (idx >= lines.size()) break;
    sc.add(lines[idx], &F_BODY, C_TEXT, M, Y_REPLY_BODY + i * REPLY_LEADING);
  }
  return sc;
}

static Screen scr_problem(const String& title, const String& reason, const String& next) {
  Screen sc;
  sc.name = "problem";
  add_title(sc, title, C_ORANGE);
  add_two_lines(sc, reason, C_TEXT);
  sc.add(fit(next, &F_META, TEXT_W), &F_META, C_DIM, M, Y_META);
  return sc;
}

static Screen scr_cancelled() {
  Screen sc;
  sc.name = "cancelled";
  add_title(sc, "Cancelled", C_DIM);
  sc.add("Nothing was sent", &F_META, C_DIM, M, Y_META);
  return sc;
}

static Screen scr_notice(const String& text) {
  Screen sc;
  sc.name = "notice";
  add_title(sc, text, C_DIM);
  return sc;
}

static Screen scr_updating(const char* version, int pct, bool restarting) {
  Screen sc;
  sc.name = "updating";
  add_title(sc, restarting ? "Restarting" : "Updating", C_SKY);
  sc.add("to " + short_version(version), &F_BODY, C_TEXT, M, Y_BODY1);
  sc.progress = (int8_t)(pct < 0 ? 0 : pct > 100 ? 100 : pct);
  sc.add(String(sc.progress) + "%", &F_META, C_DIM, M, Y_META);
  return sc;
}

static void draw_paw(int cx, int cy, int s, uint16_t color) {
  canvas.fillEllipse(cx, cy + s * 35 / 100, s * 48 / 100, s * 36 / 100, color);
  int r = s * 18 / 100 + 1;
  canvas.fillCircle(cx - s * 58 / 100, cy - s * 8 / 100, r, color);
  canvas.fillCircle(cx - s * 22 / 100, cy - s * 45 / 100, r, color);
  canvas.fillCircle(cx + s * 22 / 100, cy - s * 45 / 100, r, color);
  canvas.fillCircle(cx + s * 58 / 100, cy - s * 8 / 100, r, color);
}

static String drawn_key;
static const char* logged_name = "";

static void paint(const Screen& sc) {
  String key = sc.key();
  if (key == drawn_key) return;
  drawn_key = key;
  if (strcmp(sc.name, logged_name)) {
    logged_name = sc.name;
    Serial.printf("[%lu] screen %s %s\n", millis(), sc.name, sc.n ? sc.texts[0].s.c_str() : "");
  }
  canvas.fillScreen(C_BG);
  if (sc.check) {
    canvas.drawWideLine(M + 1, 26, M + 7, 32, 1.6f, C_GREEN);
    canvas.drawWideLine(M + 7, 32, M + 17, 18, 1.6f, C_GREEN);
  }
  if (sc.paw) draw_paw(M + 6, 16, 10, C_GREEN);
  if (sc.bars) {
    int x0 = (W - (BARS * (BAR_W + BAR_GAP) - BAR_GAP)) / 2;
    for (int i = 0; i < BARS; i++) {
      int h = sc.levels[i];
      canvas.fillRect(x0 + i * (BAR_W + BAR_GAP), BARS_Y - h / 2, BAR_W, h, C_YELLOW);
    }
  }
  if (sc.progress >= 0) {
    canvas.fillRoundRect(M, 92, TEXT_W, 4, 2, C_TRACK);
    int fill = TEXT_W * sc.progress / 100;
    if (fill > 0) canvas.fillRoundRect(M, 92, fill < 4 ? 4 : fill, 4, 2, C_SKY);
  }
  for (int i = 0; i < sc.n; i++) {
    const Text& t = sc.texts[i];
    canvas.setFont(t.font);
    canvas.setTextDatum(t.datum);
    canvas.setTextColor(t.color);
    canvas.drawString(t.s, t.x, t.y);
  }
  canvas.pushSprite(0, 0);
}

static String clock_text() {
  time_t now = time(nullptr);
  if (now < 1700000000) return "--:--";
  now += rtc_utc_offset;
  struct tm t;
  gmtime_r(&now, &t);
  char buf[8];
  snprintf(buf, sizeof buf, "%02d:%02d", t.tm_hour, t.tm_min);
  return buf;
}

// Power
static bool on_usb() {
  int16_t vbus = M5.Power.getVBUSVoltage();
  if (vbus >= 0) return vbus > 4000;
  return M5.Power.isCharging();
}

static int battery_percent() {
  int p = M5.Power.getBatteryLevel();
  return p < 0 ? 0 : (p > 100 ? 100 : p);
}

static bool usb_power = true;
static int rssi_cached = 0;

// Wire helpers
static bool send_frame(WiFiClient& c, char type, const void* data, size_t len) {
  uint8_t hdr[3] = {(uint8_t)type, (uint8_t)(len & 0xff), (uint8_t)(len >> 8)};
  if (c.write(hdr, 3) != 3) return false;
  return len == 0 || c.write(static_cast<const uint8_t*>(data), len) == len;
}

static void send_hello(WiFiClient& c) {
  uint8_t mac[6];
  WiFi.macAddress(mac);
  char line[96];
  snprintf(line, sizeof line, "M5R1 %02x%02x%02x%02x%02x%02x %d %s\n", mac[0], mac[1], mac[2], mac[3], mac[4],
           mac[5], batt_cached.load(), FW_VERSION);
  c.print(line);
}

static String read_line_from(WiFiClient& c, String& partial, bool& got) {
  got = false;
  while (c.available()) {
    char ch = c.read();
    if (ch == '\n') {
      String out = partial;
      partial = "";
      out.trim();
      got = true;
      return out;
    }
    if (partial.length() < REPLY_MAX * 3 + 64) partial += ch;
  }
  return "";
}

static void log_rx(const char* who, const String& line) {
  Serial.printf("[%lu] %s rx %s\n", millis(), who,
                line.length() > 60 ? (line.substring(0, 60) + "...").c_str() : line.c_str());
}

static bool set_clock(const String& line) {
  long long epoch = 0;
  long offset = 0;
  if (sscanf(line.c_str() + 5, "%lld %ld", &epoch, &offset) < 1 || epoch <= 1700000000) return false;
  struct timeval tv = {(time_t)epoch, 0};
  settimeofday(&tv, nullptr);
  rtc_utc_offset = offset;
  return true;
}

// Network task: WiFi, the watch connection, mDNS and OTA, on core 0 so none of it freezes the screen.
enum class NetReq : uint8_t { None, Scan, Drop };
static std::atomic<uint8_t> net_req{(uint8_t)NetReq::None};
static std::atomic<uint32_t> net_req_secs{0};

static uint32_t wifi_begin_ms = 0;
static bool wifi_fast_join = false;
static bool wifi_logged_up = false;
static bool mdns_started = false;

// Logs why a join failed (201 no AP with that name, 15 or 204 wrong password, 2 or 202 auth rejected), never the
// network name or password.
static void on_wifi_event(WiFiEvent_t event, WiFiEventInfo_t info) {
  if (event == ARDUINO_EVENT_WIFI_STA_DISCONNECTED) {
    Serial.printf("[%lu] wifi disconnected reason=%u\n", millis(), info.wifi_sta_disconnected.reason);
  }
}

static void wifi_start() {
  static bool handler = false;
  if (!handler) {
    WiFi.onEvent(on_wifi_event);
    handler = true;
  }
  WiFi.persistent(false);
  WiFi.mode(WIFI_STA);
  wifi_begin_ms = millis();
  wifi_fast_join = rtc_wifi_channel > 0;
  if (wifi_fast_join) {
    WiFi.begin(TS_WIFI_SSID, TS_WIFI_PASS, rtc_wifi_channel, rtc_wifi_bssid, true);
  } else {
    WiFi.begin(TS_WIFI_SSID, TS_WIFI_PASS);
  }
  Serial.printf("[%lu] wifi joining (%s)\n", millis(), wifi_fast_join ? "cached channel" : "scan");
}

// Reports whether the configured network is visible, with channel, signal and security, and how many networks
// are visible in total. Names are compared on the stick and never printed.
static void wifi_scan_report() {
  WiFi.disconnect(false);
  delay(200);
  int n = WiFi.scanNetworks(false, true);
  String want = String(TS_WIFI_SSID);
  String want_lc = want;
  want_lc.toLowerCase();
  int exact = 0;
  for (int i = 0; i < n; i++) {
    String got = WiFi.SSID(i);
    String got_lc = got;
    got_lc.toLowerCase();
    const char* kind = got == want ? "exact" : got_lc == want_lc ? "same-ignoring-case"
                       : (got_lc.indexOf(want_lc) >= 0 || (got_lc.length() && want_lc.indexOf(got_lc) >= 0)) ? "contains"
                       : nullptr;
    if (got == want) exact++;
    if (kind) {
      Serial.printf("[%lu] scan: %s match ch=%ld rssi=%ld auth=%d len=%u\n", millis(), kind, (long)WiFi.channel(i),
                    (long)WiFi.RSSI(i), (int)WiFi.encryptionType(i), got.length());
    }
  }
  Serial.printf("[%lu] scan: %d networks visible on 2.4 GHz, exact matches %d, configured name length %u\n", millis(),
                n, exact, want.length());
  WiFi.scanDelete();
  wifi_start();
}

static void wifi_poll() {
  bool up = WiFi.status() == WL_CONNECTED;
  if (up && !wifi_logged_up) {
    wifi_logged_up = true;
    rtc_wifi_channel = WiFi.channel();
    memcpy(rtc_wifi_bssid, WiFi.BSSID(), 6);
    Serial.printf("[%lu] wifi up ip=%s rssi=%d after %lu ms\n", millis(), WiFi.localIP().toString().c_str(),
                  WiFi.RSSI(), millis() - wifi_begin_ms);
  } else if (!up && wifi_logged_up) {
    wifi_logged_up = false;
    wifi_begin_ms = millis();
    Serial.printf("[%lu] wifi down\n", millis());
  }
  if (up) return;
  if (wifi_fast_join && millis() - wifi_begin_ms > FAST_JOIN_MS) {
    Serial.printf("[%lu] wifi cached join failed, scanning\n", millis());
    rtc_wifi_channel = 0;
    WiFi.disconnect();
    wifi_start();
  } else if (millis() - wifi_begin_ms > REJOIN_MS) {
    diag("wifi not joined in %lus, rejoining", (unsigned long)(REJOIN_MS / 1000));
    WiFi.disconnect();
    wifi_start();
  }
}

static bool watch_try(WiFiClient& c, IPAddress ip, uint16_t port, const char* via, uint32_t timeout_ms) {
  uint32_t t0 = millis();
  if (!c.connect(ip, port, timeout_ms)) {
    diag("connect %s %s:%u failed %lums", via, ip.toString().c_str(), port, millis() - t0);
    return false;
  }
  c.setNoDelay(true);
  rtc_host_ip = (uint32_t)ip;
  rtc_host_port = port;
  {
    Lock l;
    sh.ip = ip;
    sh.port = port;
  }
  Serial.printf("[%lu] watch connected %s %s:%u (%lu ms)\n", millis(), via, ip.toString().c_str(), port,
                millis() - t0);
  return true;
}

// The cached host, then the Bonjour service, then the fallback host name.
static bool watch_connect(WiFiClient& c) {
  if (rtc_host_ip && watch_try(c, IPAddress(rtc_host_ip), rtc_host_port, "cached", CACHED_CONNECT_MS)) return true;
  if (!mdns_started) {
    char name[24];
    snprintf(name, sizeof name, "talkstick-%06lx", (unsigned long)(ESP.getEfuseMac() >> 24) & 0xffffff);
    mdns_started = MDNS.begin(name);
  }
  uint32_t t0 = millis();
  int n = MDNS.queryService(TS_SERVICE, "tcp");
  if (n <= 0) diag("mdns _%s._tcp found none %lums", TS_SERVICE, millis() - t0);
  for (int i = 0; i < n; i++) {
    IPAddress ip = MDNS.address(i);
    if (!(uint32_t)ip && MDNS.hostname(i).length()) {
      // Some responders (macOS dns-sd -R) answer the service without an A record; resolve its host name instead.
      String h = MDNS.hostname(i);
      if (h.endsWith(".local")) h.remove(h.length() - 6);
      ip = MDNS.queryHost(h.c_str(), 2000);
      if (!(uint32_t)ip) diag("mdns service host not resolved");
    }
    if ((uint32_t)ip && watch_try(c, ip, MDNS.port(i), "mdns", CACHED_CONNECT_MS)) return true;
  }
  String host = TS_HOST_FALLBACK;
  if (host.endsWith(".local")) host.remove(host.length() - 6);
  if (host.length()) {
    t0 = millis();
    IPAddress ip = MDNS.queryHost(host.c_str(), 2000);
    if (!(uint32_t)ip) diag("fallback host not found %lums", millis() - t0);
    else if (watch_try(c, ip, TS_PORT, "host", CACHED_CONNECT_MS)) return true;
  }
  return false;
}

#ifdef TS_OTA_KEY
struct OtaOffer {
  bool pending = false;
  uint32_t size = 0;
  char sha[65] = "";
  char version[24] = "";
};
static OtaOffer offer;

static void to_hex(const uint8_t* b, size_t n, char* out) {
  for (size_t i = 0; i < n; i++) sprintf(out + 2 * i, "%02x", b[i]);
  out[2 * n] = 0;
}

static void ota_offer_line(const String& line) {
  unsigned size = 0;
  char sha[65], mac[65], version[24];
  if (sscanf(line.c_str() + 4, "%u %64s %64s %23s", &size, sha, mac, version) != 4) {
    diag("ota offer unreadable");
    return;
  }
  if (!strcmp(version, FW_VERSION)) {
    diag("ota offer is the running version %s", version);
    return;
  }
  char msg[120];
  int n = snprintf(msg, sizeof msg, "talkstick-ota %s %s", sha, version);
  uint8_t want[32];
  char want_hex[65];
  mbedtls_md_hmac(mbedtls_md_info_from_type(MBEDTLS_MD_SHA256), OTA_KEY, sizeof OTA_KEY, (const uint8_t*)msg, n, want);
  to_hex(want, 32, want_hex);
  if (strcasecmp(want_hex, mac)) {
    diag("ota offer %s has a bad mac", version);
    return;
  }
  offer.pending = true;
  offer.size = size;
  copy_str(offer.sha, sizeof offer.sha, String(sha));
  copy_str(offer.version, sizeof offer.version, String(version));
  Serial.printf("[%lu] ota offer %s %u bytes\n", millis(), version, size);
}

static void set_ota(OtaState st, int pct) {
  Lock l;
  sh.ota = st;
  sh.ota_pct = pct;
  copy_str(sh.ota_version, sizeof sh.ota_version, String(offer.version));
}

// Returns only on failure; on success the stick restarts into the new slot.
static void ota_run(IPAddress ip, uint16_t port) {
  offer.pending = false;
  rec.armed.store(false);
  if (rec.active.load()) {
    rec.armed.store(true);
    offer.pending = true;
    return;
  }
  set_ota(OtaState::Running, 0);
  WiFiClient c;
  bool begun = false;
  const char* why = nullptr;
  char why_buf[64];
  uint32_t got = 0;
  mbedtls_sha256_context ctx;
  mbedtls_sha256_init(&ctx);
  do {
    if (!c.connect(ip, port, 3000)) { why = "connect failed"; break; }
    send_hello(c);
    send_frame(c, 'F', offer.version, strlen(offer.version));
    String partial, head;
    bool line_got = false;
    uint32_t t0 = millis();
    // The daemon answers every hello with TIME first; the image header is the first IMAGE or ERR line.
    while (millis() - t0 < 10000 && (c.connected() || c.available())) {
      head = read_line_from(c, partial, line_got);
      if (line_got && (head.startsWith("IMAGE ") || head.startsWith("ERR"))) break;
      line_got = false;
      delay(5);
    }
    unsigned size = 0;
    char sha[65] = "";
    if (!line_got || sscanf(head.c_str(), "IMAGE %u %64s", &size, sha) != 2) {
      snprintf(why_buf, sizeof why_buf, "no image header (%.40s)", head.c_str());
      why = why_buf;
      break;
    }
    if (size != offer.size || strcasecmp(sha, offer.sha)) { why = "image differs from the offer"; break; }
    if (!Update.begin(size, U_FLASH)) {
      snprintf(why_buf, sizeof why_buf, "begin: %s", Update.errorString());
      why = why_buf;
      break;
    }
    begun = true;
    mbedtls_sha256_starts(&ctx, 0);
    static uint8_t buf[2048];
    uint32_t last = millis();
    int shown = -1;
    while (got < size) {
      int n = c.read(buf, size - got < sizeof buf ? size - got : sizeof buf);
      if (n > 0) {
        mbedtls_sha256_update(&ctx, buf, n);
        if (Update.write(buf, n) != (size_t)n) { why = "flash write failed"; break; }
        got += n;
        last = millis();
        int pct = (int)((uint64_t)got * 100 / size);
        if (pct != shown) { shown = pct; set_ota(OtaState::Running, pct); }
      } else if (!c.connected() && !c.available()) {
        why = "closed early";
        break;
      } else if (millis() - last > 15000) {
        why = "stalled";
        break;
      } else {
        delay(2);
      }
    }
    if (why) break;
    uint8_t digest[32];
    char hex[65];
    mbedtls_sha256_finish(&ctx, digest);
    to_hex(digest, 32, hex);
    if (strcasecmp(hex, offer.sha)) { why = "sha256 mismatch"; break; }
    if (!Update.end(true)) {
      snprintf(why_buf, sizeof why_buf, "end: %s", Update.errorString());
      why = why_buf;
      break;
    }
  } while (false);
  mbedtls_sha256_free(&ctx);
  c.stop();
  if (!why) {
    Serial.printf("[%lu] ota %s written, restarting\n", millis(), offer.version);
    set_ota(OtaState::Restarting, 100);
    delay(500);
    ESP.restart();
  }
  if (begun) Update.abort();
  diag("ota %s failed at %lu bytes: %s", offer.version, (unsigned long)got, why);
  request_sound(Sound::Error);
  set_ota(OtaState::None, 0);
  rec.armed.store(true);
}
#endif

static void watch_line(WiFiClient& c, const String& line, bool& got_time) {
  if (line.startsWith("TIME ")) {
    if (set_clock(line) && !got_time) {
      got_time = true;
      if (probation.load()) {
        esp_ota_mark_app_valid_cancel_rollback();
        probation.store(false);
        rtc_updated_epoch = time(nullptr);
        Serial.printf("[%lu] %s marked valid\n", millis(), FW_VERSION);
      }
    }
  } else if (line.startsWith("QUEUE ")) {
    int v[4] = {0, 0, 0, 0};
    int n = sscanf(line.c_str() + 6, "%d %d %d %d", &v[0], &v[1], &v[2], &v[3]);
    if (n >= 3) {
      Lock l;
      sh.queue_known = true;
      sh.waiting = v[0];
      sh.busy = v[1];
      sh.ahead = v[2];
      sh.paused = n >= 4 ? v[3] : 0;
    }
  } else if (line.startsWith("ANSWER ")) {
    log_rx("watch", line);
    char id[9], outcome[12];
    int used = 0;
    if (sscanf(line.c_str() + 7, "%8s %11s%n", id, outcome, &used) != 2) return;
    const char* rest = line.c_str() + 7 + used;
    if (*rest == ' ') rest++;
    const char* tab = strchr(rest, '\t');
    String said = tab ? String(rest).substring(0, tab - rest) : String(rest);
    String text = tab ? String(tab + 1) : String();
    char oc = !strcmp(outcome, "replied") ? 'r' : !strcmp(outcome, "offline") ? 'o' : 'e';
    bool fresh;
    {
      Lock l;
      fresh = inbox_add(id, oc, said, text);
      items_remove(id);
      if (!strcmp(sh.status_id, id)) sh.status_id[0] = 0;
    }
    send_frame(c, 'K', id, strlen(id));
    if (fresh) request_sound(oc == 'r' ? Sound::Replied : Sound::Error);
  } else if (line.startsWith("OTA ")) {
    log_rx("watch", line);
#ifdef TS_OTA_KEY
    ota_offer_line(line);
#endif
  }
}

static LinkState compute_link(bool wifi_up, bool watch_on, bool got_time, uint32_t now, uint32_t wifi_down_since,
                              uint32_t search_since, uint32_t last_line_ms) {
  if (!wifi_up) return now - wifi_down_since < JOIN_GRACE_MS ? LinkState::Joining : LinkState::NoWifi;
  if (watch_on && got_time && now - last_line_ms < WATCH_SILENCE_MS) return LinkState::Up;
  return now - search_since < SEARCH_GRACE_MS ? LinkState::Searching : LinkState::Unreachable;
}

static void net_task(void*) {
  WiFiClient watch;
  String partial;
  bool watch_on = false, got_time = false, wifi_was_up = false, ps = false;
  uint32_t wifi_down_since = millis(), search_since = 0, next_try = 0, last_line = 0, drop_until = 0;
  int fails = 0;
  wifi_start();
  WiFi.setSleep(false);
  auto close_watch = [&](const char* why) {
    if (!watch_on) return;
    if (why) diag("%s", why);
    watch.stop();
    watch_on = false;
    got_time = false;
    partial = "";
    search_since = millis();
    fails = 0;
    next_try = 0;
  };
  for (;;) {
    uint32_t now = millis();
    NetReq req = (NetReq)net_req.exchange((uint8_t)NetReq::None);
    if (req == NetReq::Scan) {
      close_watch(nullptr);
      wifi_scan_report();
    } else if (req == NetReq::Drop) {
      close_watch(nullptr);
      WiFi.disconnect();
      drop_until = now + net_req_secs.load() * 1000;
      if (!drop_until) drop_until = 1;
      Serial.printf("[%lu] wifi dropped for %lu s\n", now, (unsigned long)net_req_secs.load());
    }
    if (drop_until && (int32_t)(now - drop_until) >= 0) {
      drop_until = 0;
      wifi_start();
    }
    if (!drop_until) wifi_poll();
    bool wifi_up = !drop_until && WiFi.status() == WL_CONNECTED;
    if (wifi_up != wifi_was_up) {
      wifi_was_up = wifi_up;
      if (wifi_up) {
        search_since = now;
        fails = 0;
        next_try = 0;
      } else {
        wifi_down_since = now;
        close_watch(watch_on ? "wifi dropped, watch closed" : nullptr);
      }
    }

    if (wifi_up && !watch_on && (int32_t)(now - next_try) >= 0) {
      if (watch_connect(watch)) {
        watch_on = true;
        got_time = false;
        last_line = millis();
        send_hello(watch);
        send_frame(watch, 'W', nullptr, 0);
        static char logbuf[DIAG_MAX];
        size_t n = diag_take(logbuf);
        if (n) send_frame(watch, 'L', logbuf, n);
      } else {
        fails++;
        next_try = millis() + (fails >= 3 ? 3000 : fails * 1000);
      }
    }

    if (watch_on) {
      for (int k = 0; k < 8; k++) {
        bool got;
        String line = read_line_from(watch, partial, got);
        if (!got) break;
        last_line = millis();
        if (line.length()) watch_line(watch, line, got_time);
      }
      if (!watch.connected() && !watch.available()) close_watch("watch closed by the Mac");
      else if (millis() - last_line > WATCH_SILENCE_MS) close_watch("watch silent 12s");
    }

    now = millis();
    LinkState link = compute_link(wifi_up, watch_on, got_time, now, wifi_down_since, search_since, last_line);
    bool keep_awake, main_idle;
    IPAddress ip;
    uint16_t port;
    {
      Lock l;
      sh.link = link;
      sh.last_line_ms = last_line;
      if (!watch_on) sh.queue_known = false;
      keep_awake = sh.keep_awake;
      main_idle = sh.main_idle;
      ip = sh.ip;
      port = sh.port;
    }
    bool want_ps = !keep_awake;
    if (want_ps != ps && !drop_until) {
      ps = want_ps;
      WiFi.setSleep(ps);
      Lock l;
      sh.wifi_ps = ps;
    }
#ifdef TS_OTA_KEY
    if (offer.pending && link == LinkState::Up && main_idle) {
      ota_run(ip, port);
      last_line = millis();
    }
#else
    (void)main_idle;
    (void)ip;
    (void)port;
#endif
    vTaskDelay(pdMS_TO_TICKS(20));
  }
}

// Utterance lifecycle, main loop.
enum class Phase { Idle, Recording, Finishing, Sending, Retrying, Result, Reading };
enum class Step { Link, Upload, Transcribing, Posting };

static const char* phase_name(Phase p) {
  switch (p) {
    case Phase::Idle: return "idle";
    case Phase::Recording: return "recording";
    case Phase::Finishing: return "finishing";
    case Phase::Sending: return "sending";
    case Phase::Retrying: return "retrying";
    case Phase::Result: return "result";
    case Phase::Reading: return "reading";
  }
  return "?";
}

struct Utterance {
  Phase phase = Phase::Idle;
  uint32_t seq = 0;
  char id[9] = "";
  bool status = false;
  bool connected = false;
  size_t sent_bytes = 0;
  uint32_t connect_try_ms = 0;
  uint32_t e_ms = 0;
  uint32_t next_try_ms = 0;
  uint8_t attempt = 0;
  Step step = Step::Link;
  String reason;
  String line;
};
static Utterance utt;
static WiFiClient sock;
static Screen result_screen;
static uint32_t result_since = 0, result_hold = 0;
static uint32_t last_activity_ms = 0, last_button_ms = 0, last_delivery_ms = 0;
static uint8_t level_hist[BARS];
static size_t level_chunks = 0;
static bool mic_live = false;

struct Reading {
  Answer a;
  std::vector<String> lines;
  int page = 0;
  uint32_t since = 0;
  uint32_t hold = 0;
};
static Reading reading;

static Screen demo_screen;
static uint32_t demo_until = 0;

[[noreturn]] static void enter_deep_sleep(const char* why);

static void close_sock() {
  if (sock.connected()) sock.stop();
  utt.connected = false;
  utt.line = "";
}

static void go_idle() {
  close_sock();
  utt.phase = Phase::Idle;
  last_activity_ms = millis();
}

static void show_result(const Screen& sc, uint32_t hold_ms) {
  close_sock();
  result_screen = sc;
  result_since = millis();
  result_hold = hold_ms;
  utt.phase = Phase::Result;
  last_activity_ms = millis();
}

static void final_problem(const String& title, const String& reason, const String& next) {
  request_sound(Sound::Error);
  rec.armed.store(true);
  show_result(scr_problem(title, reason, next), PROBLEM_HOLD_MS);
}

static void fail_retryable(const String& reason, uint32_t delay_ms = 0) {
  close_sock();
  uint32_t now = millis();
  diag("utt %s try %u: %s", utt.id, utt.attempt + 1, reason.c_str());
  rec.armed.store(true);
  if (now - rec.release_ms.load() >= RETRY_WINDOW_MS) {
    final_problem("Not sent", reason, "Hold A to say it again");
    return;
  }
  if (utt.attempt == 0) request_sound(Sound::Error);
  utt.attempt++;
  if (!delay_ms) delay_ms = utt.attempt == 1 ? 2000 : utt.attempt == 2 ? 4000 : 8000;
  utt.next_try_ms = now + delay_ms;
  utt.reason = reason;
  utt.phase = Phase::Retrying;
}

static void open_reading(int idx) {
  {
    Lock l;
    if (idx < 0 || idx >= rtc_inbox_n) return;
    reading.a = rtc_inbox[idx];
  }
  close_sock();
  reading.lines = wrap_text(reading.a.text, &F_BODY, TEXT_W);
  reading.page = 0;
  reading.since = millis();
  uint32_t hold = REPLY_BASE_MS + REPLY_PER_CHAR_MS * strlen(reading.a.text);
  reading.hold = hold > REPLY_MAX_HOLD_MS ? REPLY_MAX_HOLD_MS : hold;
  utt.phase = Phase::Reading;
  last_activity_ms = millis();
}

static void mark_read(const char* id) {
  Lock l;
  int i = inbox_find(id);
  if (i >= 0) rtc_inbox[i].read = true;
}

static int reply_pages() {
  return reading.lines.empty() ? 1 : (int)((reading.lines.size() + REPLY_LINES - 1) / REPLY_LINES);
}

static void press_b() {
  uint32_t now = millis();
  last_activity_ms = now;
  last_button_ms = now;
  switch (utt.phase) {
    case Phase::Recording:
      rec.cancel_req.store(true);
      Serial.printf("[%lu] B: cancel\n", now);
      break;
    case Phase::Reading: {
      mark_read(reading.a.id);
      if (reading.page + 1 < reply_pages()) {
        reading.page++;
        reading.since = now;
        break;
      }
      int next;
      {
        Lock l;
        int i = inbox_find(reading.a.id);
        next = i >= 0 && i + 1 < rtc_inbox_n ? i + 1 : -1;
      }
      if (next >= 0) open_reading(next);
      else go_idle();
      break;
    }
    case Phase::Idle:
    case Phase::Result: {
      int newest;
      {
        Lock l;
        newest = rtc_inbox_n - 1;
      }
      if (newest >= 0) open_reading(newest);
      else show_result(scr_notice("No replies yet"), NOTICE_HOLD_MS);
      break;
    }
    default:
      break;
  }
}

static uint8_t level_of_chunk(size_t chunk) {
  const int16_t* p = rec.buf + chunk * CHUNK_SAMPLES;
  double sum = 0;
  for (size_t i = 0; i < CHUNK_SAMPLES; i++) sum += (double)p[i] * p[i];
  double rms = sqrt(sum / CHUNK_SAMPLES);
  if (rms > 0) mic_live = true;
  float db = rms > 1 ? 20.0f * log10f(rms / 32768.0f) : -90.0f;
  float level = (db + 60.0f) / 60.0f;
  level = level < 0 ? 0 : (level > 1 ? 1 : level);
  return (uint8_t)(BAR_MIN + level * (BAR_MAX - BAR_MIN));
}

static void update_levels() {
  size_t chunks = rec.done_bytes.load() / CHUNK_BYTES;
  while (level_chunks < chunks) {
    memmove(level_hist, level_hist + 1, BARS - 1);
    level_hist[BARS - 1] = level_of_chunk(level_chunks++);
  }
}

static bool open_utt_socket(const Shared& s) {
  utt.connect_try_ms = millis();
  if (s.link != LinkState::Up || !s.port) return false;
  uint32_t t0 = millis();
  if (!sock.connect(s.ip, s.port, UTT_CONNECT_MS)) {
    diag("utt %s connect %s:%u failed %lums", utt.id, s.ip.toString().c_str(), s.port, millis() - t0);
    return false;
  }
  sock.setNoDelay(true);
  utt.connected = true;
  utt.sent_bytes = 0;
  utt.line = "";
  send_hello(sock);
  return true;
}

static void stream_ready_audio() {
  size_t ready = rec.done_bytes.load();
  const uint8_t* base = reinterpret_cast<const uint8_t*>(rec.buf);
  while (utt.connected && utt.sent_bytes < ready) {
    size_t n = ready - utt.sent_bytes;
    if (n > FRAME_MAX_BYTES) n = FRAME_MAX_BYTES;
    if (!send_frame(sock, 'A', base + utt.sent_bytes, n)) {
      Serial.printf("[%lu] send failed at %u bytes\n", millis(), (unsigned)utt.sent_bytes);
      close_sock();
      return;
    }
    utt.sent_bytes += n;
  }
}

static bool status_pending(const Shared& s, uint32_t now) {
  return s.status_id[0] && now - s.status_ms < STATUS_GUARD_MS;
}

static void delivered(const String& said) {
  uint32_t now = millis();
  request_sound(Sound::Sent);
  last_delivery_ms = now;
  int waiting;
  {
    Lock l;
    items_remove(utt.id);
    if (sh.n_items == ITEMS_N) {
      memmove(&sh.items[0], &sh.items[1], (ITEMS_N - 1) * sizeof(Item));
      sh.n_items--;
    }
    Item& it = sh.items[sh.n_items++];
    copy_str(it.id, sizeof it.id, String(utt.id));
    copy_str(it.said, sizeof it.said, said);
    it.sent_ms = now;
    if (utt.status) {
      copy_str(sh.status_id, sizeof sh.status_id, String(utt.id));
      sh.status_ms = now;
    }
    waiting = waiting_count(sh);
  }
  Serial.printf("[%lu] utt %s delivered after %u tries\n", now, utt.id, utt.attempt + 1);
  show_result(scr_delivered(said, waiting), DELIVERED_HOLD_MS);
}

static void handle_err(const String& reason) {
  if (reason == "busy") { fail_retryable("The Mac is still on it", BUSY_RETRY_MS); return; }
  diag("utt %s ERR %s", utt.id, reason.c_str());
  if (reason.startsWith("empty")) final_problem("Didn't catch that", "Nothing was heard", "Hold A a little longer");
  else if (reason.startsWith("delivery")) final_problem("Couldn't post", reason.substring(8), "Nothing was posted");
  else if (reason.startsWith("whisper")) final_problem("Transcription failed", reason.substring(7), "Nothing was posted");
  else final_problem("Something failed", reason, "Nothing was posted");
}

static void utt_line(const String& line) {
  log_rx("utt", line);
  if (line == "RECV") {
    utt.step = Step::Transcribing;
  } else if (line.startsWith("ID ")) {
    String id = line.substring(3);
    id.trim();
    if (id != utt.id) diag("utt %s answered as %s", utt.id, id.c_str());
    utt.step = Step::Posting;
  } else if (line == "SENT" || line.startsWith("SENT ")) {
    String said = line.length() > 5 ? line.substring(5) : String();
    delivered(sanitize_reply(said, SAID_MAX));
  } else if (line == "OFFLINE") {
    diag("utt %s OFFLINE", utt.id);
    final_problem("Driver offline", "No live driver thread", "Nothing was posted");
  } else if (line.startsWith("ERR")) {
    String reason = line.substring(3);
    reason.trim();
    handle_err(reason);
  } else if (line.startsWith("TIME ")) {
    set_clock(line);
  }
}

static void sending_step(const Shared& s, uint32_t now) {
  if (!utt.connected) {
    if (s.link != LinkState::Up || !s.port) {
      if (utt.attempt > 0 || now - rec.release_ms.load() > NO_LINK_MS) {
        fail_retryable(s.link == LinkState::Joining || s.link == LinkState::NoWifi ? "No WiFi" : "Can't reach the Mac");
      }
      return;
    }
    if (!open_utt_socket(s)) { fail_retryable("Couldn't connect to the Mac"); return; }
  }
  if (!utt.e_ms) {
    if (!utt.status) stream_ready_audio();
    if (!utt.connected || !send_frame(sock, utt.status ? 'S' : 'E', utt.id, 8)) {
      fail_retryable("Upload was cut off");
      return;
    }
    utt.e_ms = now;
    utt.step = Step::Upload;
    rec.armed.store(true);
    Serial.printf("[%lu] utt %s tx %c, audio %u bytes, try %u\n", now, utt.id, utt.status ? 'S' : 'E',
                  (unsigned)utt.sent_bytes, utt.attempt + 1);
    return;
  }
  for (;;) {
    bool got;
    String line = read_line_from(sock, utt.line, got);
    if (!got) break;
    if (line.length()) utt_line(line);
    if (utt.phase != Phase::Sending) return;
  }
  if (!sock.connected() && !sock.available()) fail_retryable("The Mac closed the link");
  else if (now - utt.e_ms > SENT_TIMEOUT_MS) fail_retryable("No word from the Mac in 45 s");
}

static void start_utterance(uint32_t seq) {
  if (utt.phase == Phase::Sending || utt.phase == Phase::Retrying) {
    diag("utt %s abandoned by a new press (%s)", utt.id, phase_name(utt.phase));
  }
  close_sock();
  utt = Utterance{};
  utt.seq = seq;
  utt.phase = Phase::Recording;
  snprintf(utt.id, sizeof utt.id, "%08lx", (unsigned long)esp_random());
  rec.armed.store(false);
  memset(level_hist, BAR_MIN, sizeof level_hist);
  level_chunks = 0;
  mic_live = false;
  last_activity_ms = last_button_ms = millis();
  Serial.printf("[%lu] press #%lu id %s\n", millis(), (unsigned long)seq, utt.id);
}

static void utterance_step(const Shared& s) {
  uint32_t seq = rec.seq.load();
  if (seq != utt.seq) start_utterance(seq);
  uint32_t now = millis();

  switch (utt.phase) {
    case Phase::Idle: {
      int unread;
      {
        Lock l;
        unread = inbox_oldest_unread();
      }
      if (unread >= 0 && s.ota == OtaState::None) open_reading(unread);
      break;
    }

    case Phase::Recording:
      update_levels();
      if (now - rec.press_ms.load() >= STATUS_PRESS_MS && !utt.connected && now - utt.connect_try_ms > 2000) {
        open_utt_socket(s);
      }
      if (utt.connected) stream_ready_audio();
      if (!rec.active.load()) {
        utt.phase = Phase::Finishing;
        Serial.printf("[%lu] release after %lu ms%s%s\n", now,
                      (unsigned long)(rec.release_ms.load() - rec.press_ms.load()), rec.capped.load() ? " (cap)" : "",
                      rec.cancelled.load() ? " (cancel)" : "");
      }
      break;

    case Phase::Finishing: {
      update_levels();
      if (!rec.finished.load()) break;
      uint32_t dur = rec.release_ms.load() - rec.press_ms.load();
      if (rec.cancelled.load() || rec.capped.load()) {
        if (utt.connected) send_frame(sock, 'C', nullptr, 0);
        Serial.printf("[%lu] tx C (%s), %u bytes sent\n", now, rec.capped.load() ? "cap" : "button B",
                      (unsigned)utt.sent_bytes);
        rec.armed.store(true);
        if (rec.capped.load()) final_problem("Too long", "120 s is the limit", "Nothing was sent");
        else show_result(scr_cancelled(), NOTICE_HOLD_MS);
        break;
      }
      utt.status = dur < STATUS_PRESS_MS;
      if (utt.status && status_pending(s, now)) {
        rec.armed.store(true);
        show_result(scr_notice("Already asked"), NOTICE_HOLD_MS);
        break;
      }
      utt.phase = Phase::Sending;
      utt.step = Step::Link;
      sending_step(s, now);
      break;
    }

    case Phase::Sending:
      sending_step(s, now);
      break;

    case Phase::Retrying:
      if (now - rec.release_ms.load() >= RETRY_WINDOW_MS) {
        diag("utt %s not sent after 120s: %s", utt.id, utt.reason.c_str());
        final_problem("Not sent", utt.reason, "Hold A to say it again");
      } else if ((int32_t)(now - utt.next_try_ms) >= 0 && s.link == LinkState::Up) {
        utt.phase = Phase::Sending;
        utt.step = Step::Link;
        utt.e_ms = 0;
        sending_step(s, now);
      }
      break;

    case Phase::Result:
      if (now - result_since > result_hold) go_idle();
      break;

    case Phase::Reading:
      if (now - reading.since > reading.hold) {
        mark_read(reading.a.id);
        go_idle();
      }
      break;
  }
}

static String sending_step_text(const Shared& s) {
  String upload = utt.status ? String("Asking for status")
                             : "Uploading " + String(rec.done_bytes.load() / 32000.0f, 1) + " s";
  if (!utt.connected && !utt.e_ms) {
    if (s.link == LinkState::Joining || s.link == LinkState::NoWifi) return "Joining WiFi";
    if (s.link != LinkState::Up) return "Finding the Mac";
    return upload;
  }
  switch (utt.step) {
    case Step::Link:
    case Step::Upload: return upload;
    case Step::Transcribing: return "Transcribing";
    case Step::Posting: return "Posting to the thread";
  }
  return upload;
}

static bool thinking_due(const Shared& s, uint32_t now) {
  if (waiting_count(s) <= 0) return false;
  return (last_delivery_ms && now - last_delivery_ms < THINKING_AFTER_DELIVERY_MS) ||
         (last_button_ms && now - last_button_ms < THINKING_AFTER_BUTTON_MS);
}

static Screen describe(const Shared& s, uint32_t now) {
  int waiting = waiting_count(s);
  if (s.ota != OtaState::None) return scr_updating(s.ota_version, s.ota_pct, s.ota == OtaState::Restarting);
  switch (utt.phase) {
    case Phase::Recording:
    case Phase::Finishing:
      return scr_listening(mic_live, now - rec.press_ms.load(), level_hist);
    case Phase::Sending:
      return scr_sending(sending_step_text(s), waiting);
    case Phase::Retrying: {
      uint32_t left = (utt.next_try_ms - now + 999) / 1000;
      String next = s.link != LinkState::Up ? String("Will send when the Mac is back")
                    : "Trying again in " + String((int32_t)(utt.next_try_ms - now) > 0 ? left : 1) + " s";
      return scr_problem("Not sent yet", utt.reason, next);
    }
    case Phase::Result:
      return result_screen;
    case Phase::Reading:
      return scr_reply(reading.a.outcome, reading.a.said, reading.lines, reading.page);
    case Phase::Idle:
      break;
  }
  if (thinking_due(s, now)) {
    String said = s.n_items ? String(s.items[s.n_items - 1].said) : String();
    int64_t elapsed = last_delivery_ms ? (int64_t)((now - last_delivery_ms) / 1000) : -1;
    return scr_thinking(s.busy, s.ahead, s.paused, elapsed, said, waiting);
  }
  String status, meta;
  uint16_t status_color, meta_color;
  bool updated = rtc_updated_epoch && time(nullptr) - rtc_updated_epoch < (time_t)UPDATED_SHOW_S;
  link_status(s.link, updated, status, status_color);
  bool wifi_up = s.link != LinkState::Joining && s.link != LinkState::NoWifi;
  power_meta(wifi_up, rssi_cached, batt_cached.load(), usb_power, meta, meta_color);
  return scr_home(clock_text(), status, status_color, waiting, meta, meta_color);
}

static bool make_demo(const String& name, Screen& out) {
  uint8_t lv[BARS];
  for (int i = 0; i < BARS; i++) lv[i] = (uint8_t)(BAR_MIN + (BAR_MAX - BAR_MIN) * (0.5f + 0.45f * sinf(i * 0.55f)) * (i % 3 ? 0.7f : 1.0f));
  String status, meta;
  uint16_t sc, mc;
  const char* said = "Check whether the deploy finished and tell me";
  const char* reply = "The deploy finished at 09:12. All four checks passed and the preview is live. "
                      "Nothing else is waiting on you; the next run is scheduled for tonight at 22:00, "
                      "and I will tell you if it fails.";
  if (name == "idle" || name == "updated" || name == "lowbatt" || name == "idle-noconn") {
    LinkState link = name == "idle-noconn" ? LinkState::Unreachable : LinkState::Up;
    link_status(link, name == "updated", status, sc);
    power_meta(true, -52, name == "lowbatt" ? 12 : 88, name != "lowbatt", meta, mc);
    out = scr_home("09:41", status, sc, name == "idle" ? 2 : 0, meta, mc);
  } else if (name == "listening") out = scr_listening(true, 7000, lv);
  else if (name == "sending") out = scr_sending("Posting to the thread", 1);
  else if (name == "delivered") out = scr_delivered(said, 2);
  else if (name == "thinking") out = scr_thinking(0, 0, 0, 74, said, 1);
  else if (name == "queued") out = scr_thinking(1, 2, 0, 31, said, 2);
  else if (name == "paused") out = scr_thinking(0, 0, 1, 305, said, 1);
  else if (name == "reply" || name == "reply-long") {
    String text = name == "reply" ? String("Done. The preview is live and all four checks passed.")
                                  : String(reply) + " " + reply;
    out = scr_reply('r', said, wrap_text(text, &F_BODY, TEXT_W), name == "reply-long" ? 1 : 0);
  } else if (name == "noreply") {
    out = scr_reply('e', said, wrap_text("The driver thread stopped before it answered.", &F_BODY, TEXT_W), 0);
  } else if (name == "notsent-retry") out = scr_problem("Not sent yet", "The Mac closed the link", "Trying again in 4 s");
  else if (name == "notsent") out = scr_problem("Not sent", "Can't reach the Mac", "Hold A to say it again");
  else if (name == "notheard") out = scr_problem("Didn't catch that", "Nothing was heard", "Hold A a little longer");
  else if (name == "offline") out = scr_problem("Driver offline", "No live driver thread", "Nothing was posted");
  else if (name == "cancelled") out = scr_cancelled();
  else if (name == "updating") out = scr_updating("talkstick-0.3.2", 42, false);
  else return false;
  return true;
}

// Sleep
[[noreturn]] static void enter_deep_sleep(const char* why) {
  Serial.printf("[%lu] deep sleep (%s), wake on G11 level %d\n", millis(), why, PRESSED_LEVEL);
  Serial.flush();
  close_sock();
  M5.Display.setBrightness(0);
  M5.Display.sleep();
  WiFi.disconnect(true);
  WiFi.mode(WIFI_OFF);
  while (gpio_get_level(PTT_PIN) == PRESSED_LEVEL) delay(10);
  rtc_gpio_pullup_en(PTT_PIN);
  rtc_gpio_pulldown_dis(PTT_PIN);
  esp_sleep_enable_ext0_wakeup(PTT_PIN, PRESSED_LEVEL);
  esp_deep_sleep_start();
}

static void power_step(const Shared& s) {
  static uint32_t last_check = 0;
  static int bright = -1;
  uint32_t now = millis();
  if (now - last_check > 2000) {
    last_check = now;
    bool now_usb = on_usb();
    if (now_usb != usb_power) Serial.printf("[%lu] power %s\n", now, now_usb ? "usb" : "battery");
    usb_power = now_usb;
    batt_cached.store(battery_percent());
    rssi_cached = WiFi.status() == WL_CONNECTED ? WiFi.RSSI() : 0;
  }
  if (probation.load() && now > PROBATION_MS) {
    diag("%s on probation, no TIME from the watch in 120s, rolling back", FW_VERSION);
    delay(100);
    esp_ota_mark_app_invalid_rollback_and_reboot();
  }
  bool home = utt.phase == Phase::Idle && s.ota == OtaState::None && !demo_until;
  bool waiting_recent = waiting_count(s) > 0 && last_delivery_ms && now - last_delivery_ms < STAY_AWAKE_AFTER_DELIVERY_MS;
  int want = (usb_power && home && now - last_activity_ms > USB_DIM_MS) ? BRIGHT_DIM : BRIGHT_ACTIVE;
  if (want != bright) {
    bright = want;
    M5.Display.setBrightness(want);
  }
  if (!usb_power && home && !waiting_recent && !probation.load() && now - last_activity_ms > IDLE_SLEEP_MS) {
    enter_deep_sleep("idle");
  }
  bool busy = utt.phase == Phase::Recording || utt.phase == Phase::Finishing || utt.phase == Phase::Sending ||
              utt.phase == Phase::Retrying || rec.active.load();
  Lock l;
  sh.keep_awake = busy || s.ota != OtaState::None || (s.link == LinkState::Up && waiting_count(s) > 0);
  sh.main_idle = (utt.phase == Phase::Idle || utt.phase == Phase::Reading) && !rec.active.load();
}

// Serial bench
static void print_link(const Shared& s) {
  size_t diag_len;
  xSemaphoreTake(diag_mtx, portMAX_DELAY);
  diag_len = rtc_diag_len;
  xSemaphoreGive(diag_mtx);
  Serial.printf("[%lu] link %s target=%s:%u last_line=%lds diag=%u bytes\n", millis(), link_name(s.link),
                s.ip.toString().c_str(), s.port, s.last_line_ms ? (long)((millis() - s.last_line_ms) / 1000) : -1L,
                (unsigned)diag_len);
}

static void print_status(const Shared& s) {
  const esp_partition_t* part = esp_ota_get_running_partition();
  int inbox_n;
  {
    Lock l;
    inbox_n = rtc_inbox_n;
  }
  Serial.printf("[%lu] status fw=%s part=%s probation=%d phase=%s link=%s wifi=%s rssi=%d wifi_ps=%d target=%s:%u "
                "waiting=%d local=%d busy=%d ahead=%d paused=%d inbox=%d batt=%d%% vbus=%dmV usb=%d g11=%d clock=%s "
                "sound=%d psram_free=%u heap_free=%u boot=%lu\n",
                millis(), FW_VERSION, part ? part->label : "?", probation.load(), phase_name(utt.phase),
                link_name(s.link), WiFi.status() == WL_CONNECTED ? WiFi.localIP().toString().c_str() : "down",
                WiFi.status() == WL_CONNECTED ? WiFi.RSSI() : 0, s.wifi_ps, s.ip.toString().c_str(), s.port,
                s.queue_known ? s.waiting : -1, s.n_items, s.busy, s.ahead, s.paused, inbox_n, battery_percent(),
                M5.Power.getVBUSVoltage(), on_usb(), gpio_get_level(PTT_PIN), clock_text().c_str(), rtc_sound_on,
                (unsigned)ESP.getFreePsram(), (unsigned)ESP.getFreeHeap(), (unsigned long)rtc_boot_count);
}

static void print_inbox() {
  Lock l;
  Serial.printf("[%lu] inbox %u\n", millis(), rtc_inbox_n);
  for (int i = 0; i < rtc_inbox_n; i++) {
    const Answer& a = rtc_inbox[i];
    Serial.printf("  %s %c read=%d %.40s\n", a.id, a.outcome, a.read, a.text);
  }
}

static bool bench_busy() {
  return !rec.armed.load() || rec.active.load() || utt.phase == Phase::Recording || utt.phase == Phase::Finishing ||
         utt.phase == Phase::Sending || utt.phase == Phase::Retrying;
}

static void bench_pcm(size_t n) {
  if (bench_busy()) {
    Serial.printf("pcm busy\n");
    return;
  }
  n &= ~(size_t)1;
  if (n == 0 || n > BUF_BYTES) {
    Serial.printf("pcm bad length (max %u)\n", (unsigned)BUF_BYTES);
    return;
  }
  rec.armed.store(false);
  Serial.printf("pcm ready %u\n", (unsigned)n);
  uint8_t* dst = reinterpret_cast<uint8_t*>(rec.buf);
  size_t got = 0;
  uint32_t last = millis();
  while (got < n && millis() - last < 3000) {
    int avail = Serial.available();
    if (avail > 0) {
      got += Serial.readBytes(dst + got, min((size_t)avail, n - got));
      last = millis();
    } else {
      delay(1);
    }
  }
  if (got < n) {
    Serial.printf("pcm short %u of %u\n", (unsigned)got, (unsigned)n);
    rec.armed.store(true);
    return;
  }
  uint32_t now = millis();
  rec.done_bytes.store(n);
  rec.capped.store(false);
  rec.cancelled.store(false);
  rec.press_ms.store(now - n / 32);
  rec.release_ms.store(now);
  rec.finished.store(true);
  rec.seq.fetch_add(1);
  Serial.printf("pcm ok %u bytes (%u ms), streaming as an utterance\n", (unsigned)n, (unsigned)(n / 32));
}

static void bench_shot() {
  canvas.pushSprite(0, 0);
  size_t n = (size_t)canvas.width() * canvas.height() * 2;
  Serial.setTxTimeoutMs(500);
  Serial.printf("\nSHOT %d %d RGB565BE %u\n", (int)canvas.width(), (int)canvas.height(), (unsigned)n);
  const uint8_t* p = static_cast<const uint8_t*>(canvas.getBuffer());
  for (size_t off = 0; off < n; off += 512) Serial.write(p + off, min((size_t)512, n - off));
  Serial.printf("\nSHOT END\n");
  Serial.flush();
  Serial.setTxTimeoutMs(0);
}

static void serial_step(const Shared& s) {
  static String line;
  while (Serial.available()) {
    char c = Serial.read();
    if (c != '\n' && c != '\r') {
      if (line.length() < 64) line += c;
      continue;
    }
    line.trim();
    if (!line.length()) continue;
    String cmd = line;
    line = "";
    last_activity_ms = millis();
    if (cmd.startsWith("ptt")) {
      float secs = cmd.length() > 3 ? cmd.substring(3).toFloat() : 3.0f;
      if (secs <= 0) secs = 3.0f;
      uint32_t ms = (uint32_t)(secs * 1000);
      Serial.printf("[%lu] bench ptt %lu ms\n", millis(), (unsigned long)ms);
      rec.sim_until_ms.store(millis() + ms);
    } else if (cmd == "press a") {
      Serial.printf("[%lu] bench press a\n", millis());
      rec.sim_until_ms.store(millis() + 120);
    } else if (cmd == "press b") {
      press_b();
    } else if (cmd.startsWith("pcm ")) {
      bench_pcm((size_t)cmd.substring(4).toInt());
    } else if (cmd == "shot") {
      bench_shot();
    } else if (cmd == "state") {
      Serial.printf("state %s phase=%s page=%d\n", logged_name, phase_name(utt.phase), reading.page);
    } else if (cmd == "status") {
      print_status(s);
    } else if (cmd == "link" || cmd == "ping") {
      print_link(s);
    } else if (cmd == "inbox") {
      print_inbox();
    } else if (cmd.startsWith("demo ")) {
      String name = cmd.substring(5);
      name.trim();
      if (make_demo(name, demo_screen)) {
        demo_until = millis() + DEMO_MS;
        Serial.printf("[%lu] demo %s for 10 s\n", millis(), name.c_str());
      } else {
        Serial.printf("[%lu] demo names: idle idle-noconn listening sending delivered thinking queued paused reply "
                      "reply-long noreply notsent-retry notsent notheard offline cancelled updating updated lowbatt\n",
                      millis());
      }
    } else if (cmd == "gpio") {
      pinMode(PTT_PIN, INPUT);
      delay(5);
      int no_pull = digitalRead(PTT_PIN);
      pinMode(PTT_PIN, INPUT_PULLUP);
      delay(5);
      int pullup = digitalRead(PTT_PIN);
      pinMode(PTT_PIN, INPUT);
      Serial.printf("[%lu] g11 no-pull=%d pullup=%d\n", millis(), no_pull, pullup);
    } else if (cmd == "sound on" || cmd == "sound off") {
      rtc_sound_on = cmd == "sound on";
      Serial.printf("[%lu] sound %s\n", millis(), rtc_sound_on ? "on" : "off");
    } else if (cmd == "scan") {
      net_req.store((uint8_t)NetReq::Scan);
    } else if (cmd.startsWith("wifi drop")) {
      long secs = cmd.length() > 9 ? cmd.substring(9).toInt() : 10;
      net_req_secs.store(secs > 0 ? (uint32_t)secs : 10);
      net_req.store((uint8_t)NetReq::Drop);
    } else if (cmd == "sleep") {
      enter_deep_sleep("serial");
    } else if (cmd == "forget") {
      rtc_host_ip = 0;
      rtc_host_port = 0;
      rtc_wifi_channel = 0;
      Serial.printf("[%lu] cached host and wifi channel cleared\n", millis());
    } else if (cmd == "reboot") {
      ESP.restart();
    } else {
      Serial.printf("[%lu] commands: ptt <s> | press a | press b | pcm <bytes> | shot | state | status | link | ping | "
                    "inbox | demo <name> | gpio | sound on|off | scan | wifi drop <s> | sleep | forget | reboot\n",
                    millis());
    }
  }
}

static const char* wake_reason() {
  switch (esp_sleep_get_wakeup_cause()) {
    case ESP_SLEEP_WAKEUP_EXT0: return "button";
    case ESP_SLEEP_WAKEUP_UNDEFINED: return "power-on";
    default: return "other";
  }
}

// The bootloader keeps a freshly written image on probation until it is marked valid (see watch_line).
extern "C" bool verifyRollbackLater() { return true; }

void setup() {
  bool woke_by_button = esp_sleep_get_wakeup_cause() == ESP_SLEEP_WAKEUP_EXT0;
  rtc_gpio_deinit(PTT_PIN);
  if (rtc_boot_count == 0) rtc_inbox_n = 0;
  if (rtc_inbox_n > INBOX_N) rtc_inbox_n = 0;
  if (rtc_diag_magic != DIAG_MAGIC || rtc_diag_len > DIAG_MAX) {
    rtc_diag_magic = DIAG_MAGIC;
    rtc_diag_len = 0;
  }
  mtx = xSemaphoreCreateMutex();
  diag_mtx = xSemaphoreCreateMutex();

  rec.buf = static_cast<int16_t*>(ps_malloc(BUF_BYTES));

  auto cfg = M5.config();
  cfg.internal_spk = true;
  cfg.internal_mic = true;
  M5.begin(cfg);
  M5.Speaker.end();
  M5.Mic.end();
  auto mic_cfg = M5.Mic.config();
  mic_cfg.sample_rate = SAMPLE_RATE;
  M5.Mic.config(mic_cfg);

  M5.Display.setRotation(1);
  M5.Display.setBrightness(BRIGHT_ACTIVE);
  canvas.setPsram(true);
  canvas.setColorDepth(16);
  canvas.createSprite(M5.Display.width(), M5.Display.height());
  w_clock.set(FONT_CLOCK, sizeof FONT_CLOCK);
  w_title.set(FONT_TITLE, sizeof FONT_TITLE);
  w_body.set(FONT_BODY, sizeof FONT_BODY);
  w_meta.set(FONT_META, sizeof FONT_META);
  bool fonts_ok = F_CLOCK.loadFont(&w_clock) & F_TITLE.loadFont(&w_title) & F_BODY.loadFont(&w_body) &
                  F_META.loadFont(&w_meta);
  memset(level_hist, BAR_MIN, sizeof level_hist);

  xTaskCreatePinnedToCore(recorder_task, "ptt", 6144, nullptr, 5, nullptr, 1);

  Serial.setRxBufferSize(16384);
  Serial.begin(115200);
  Serial.setTxTimeoutMs(0);
  rtc_boot_count++;

  const esp_partition_t* part = esp_ota_get_running_partition();
  esp_ota_img_states_t ota_state;
  if (part && esp_ota_get_state_partition(part, &ota_state) == ESP_OK && ota_state == ESP_OTA_IMG_PENDING_VERIFY) {
    probation.store(true);
  }
  Serial.printf("\n[%lu] %s boot #%lu wake=%s part=%s probation=%d psram_buf=%s fonts=%s screen=%dx%d\n", millis(),
                FW_VERSION, (unsigned long)rtc_boot_count, wake_reason(), part ? part->label : "?", probation.load(),
                rec.buf ? "ok" : "FAILED", fonts_ok ? "ok" : "FAILED", (int)canvas.width(), (int)canvas.height());
  if (woke_by_button) Serial.printf("[%lu] woke by button A\n", millis());

  usb_power = on_usb();
  batt_cached.store(battery_percent());
  last_activity_ms = millis();
  xTaskCreatePinnedToCore(net_task, "net", 8192, nullptr, 3, nullptr, 0);
}

void loop() {
  M5.update();
  Shared s = snapshot();
  serial_step(s);
  if (M5.BtnB.wasPressed()) {
    if (demo_until) demo_until = 0;
    else press_b();
  }
  utterance_step(s);
  uint32_t now = millis();
  if (demo_until && (int32_t)(now - demo_until) >= 0) demo_until = 0;
  paint(demo_until ? demo_screen : describe(s, now));
  power_step(s);
  delay(5);
}
